## nce_lwm2m_demo/src/lwm2m/Kconfig
```kconfig
#
# Copyright (c) 2021 Nordic Semiconductor ASA
#
# SPDX-License-Identifier: LicenseRef-Nordic-5-Clause
#

config LWM2M_APP_ACCELEROMETER
	bool
	select LWM2M_IPSO_ACCELEROMETER
	select ACCELEROMETER
	help
	  Create LWM2M accelerometer object.

config LWM2M_APP_PUSH_BUTTON
	bool
	select LWM2M_IPSO_PUSH_BUTTON
	select UI_INPUT
	help
	  Create button LWM2M object(s).
	  The nRF91 series DK will have two object instances, one for each push button.

config LWM2M_APP_ONOFF_SWITCH
	bool
	select LWM2M_IPSO_ONOFF_SWITCH
	select UI_INPUT
	help
	  Create two on/off switch LWM2M objects.

config LWM2M_APP_BUZZER
	bool
	select LWM2M_IPSO_BUZZER
	depends on UI_BUZZER
	help
	  Create a buzzer LWM2M object.
	  Should not be enabled on the nRF91 series DK, as it has no buzzer.

config LWM2M_APP_LIGHT_CONTROL
	bool
	depends on LWM2M_IPSO_LIGHT_CONTROL
	depends on UI_LED
	help
	  Create light control LWM2M object(s).
	  The nRF91 series DK will have multiple object instances (one for each LED), if UI_LED_USE_GPIO is
	  chosen.
```
